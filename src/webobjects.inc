const char bulb_on_gif[] PROGMEM = {0x47, 0x49, 0x46, 0x38, 0x39, 0x61, 0x64, 0x00, 0xB4, 0x00, 
0xD5, 0xFF, 0x00, 0xC0, 0xC0, 0xC0, 0xFF, 0xFF, 0xCC, 0xFF, 0xFF, 0x99, 0xFF, 0xFF, 0x66, 0xFF, 
0xFF, 0x33, 0xFF, 0xFF, 0x00, 0xFF, 0xCC, 0xFF, 0xFF, 0xCC, 0xCC, 0xFF, 0xCC, 0x99, 0xFF, 0xCC, 
0x66, 0xFF, 0xCC, 0x33, 0xFF, 0x99, 0x99, 0xFF, 0x99, 0x66, 0xFF, 0x99, 0x33, 0xCC, 0xFF, 0xFF, 
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0x3E, 0x50, 0x02, 0x11, 0x98, 0x40, 0x04, 0x5A, 0x47, 0x41, 0x95, 0x65, 0x14, 0x04, 0x00, 0x3B};

// convert by https://tomeko.net/online_tools/file_to_hex.php?lang=en
const char avatar_jpg[] PROGMEM = {0xFF, 0xD8, 0xFF, 0xE0, 0x00, 0x10, 0x4A, 0x46, 0x49, 0x46, 0x00, 0x01, 0x01, 0x01, 0x00, 0x60, 
0x00, 0x60, 0x00, 0x00, 0xFF, 0xDB, 0x00, 0x43, 0x00, 0x20, 0x16, 0x18, 0x1C, 0x18, 0x14, 0x20, 
0x1C, 0x1A, 0x1C, 0x24, 0x22, 0x20, 0x26, 0x30, 0x50, 0x34, 0x30, 0x2C, 0x2C, 0x30, 0x62, 0x46, 
0x4A, 0x3A, 0x50, 0x74, 0x66, 0x7A, 0x78, 0x72, 0x66, 0x70, 0x6E, 0x80, 0x90, 0xB8, 0x9C, 0x80, 
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0x67, 0x38, 0xB2, 0xF6, 0x89, 0x1F, 0xFF, 0xD9};